## boards/shields/sofle_ergomech/Kconfig.defconfig
```kconfig
# Copyright (c) 2020 Ryan Cross
# SPDX-License-Identifier: MIT

if SHIELD_ERGO_TOG_LEFT

config ZMK_KEYBOARD_NAME
    default "Ergo Tog"

config ZMK_SPLIT_ROLE_CENTRAL
    default y

endif

if SHIELD_ERGO_TOG_LEFT || SHIELD_ERGO_TOG_RIGHT

config ZMK_SPLIT
    default y

endif
```

## boards/shields/sofle_ergomech/Kconfig.shield
```kconfig
# Copyright (c) 2020 Ryan Cross
# SPDX-License-Identifier: MIT

config SHIELD_ERGO_TOG_LEFT
    def_bool $(shields_list_contains,ergo_tog_left)

config SHIELD_ERGO_TOG_RIGHT
    def_bool $(shields_list_contains,ergo_tog_right)
```
